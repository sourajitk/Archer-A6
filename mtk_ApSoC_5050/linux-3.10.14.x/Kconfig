## mtk_ApSoC_5050/linux-3.10.14.x/Kconfig
```kconfig
#
# For a description of the syntax of this configuration file,
# see Documentation/kbuild/kconfig-language.txt.
#
mainmenu "Linux/$ARCH $KERNELVERSION Kernel Configuration"

config SRCARCH
	string
	option env="SRCARCH"

config SUPPORT_OPENWRT
	bool "Support OpenWrt"
	default n

choice
	prompt "Select the products"
	config PRODUCT_ARCHER_A10
	bool "PRODUCT_ARCHER_A10"

	config PRODUCT_ARCHER_C2300
	bool "PRODUCT_ARCHER_C2300"

	config PRODUCT_ARCHER_C6U
	bool "PRODUCT_ARCHER_C6U"
endchoice


source "arch/$SRCARCH/Kconfig"
```

## mtk_ApSoC_5050/linux-3.10.14.x/tplink/Kconfig
```kconfig
menu "TP-LINK kernel features"
config COS_KERNEL
	bool "use cos netlink in kernel"
	default y
	help
	enable cos kernel message feature in kernel.

endmenu
```

## packages/opensource/proftpd/Config.in
```kconfig
config proftpd-in-fit
	bool "reduce proftpd"
	default n
	depends PACKAGE_proftpd
	help
	  Feature: cut off some optionsal features of proftpd.
```
